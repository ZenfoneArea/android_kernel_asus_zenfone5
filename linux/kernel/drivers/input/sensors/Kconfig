## linux/kernel/drivers/input/sensors/Kconfig
```kconfig
#
# Sensor driver configuration
#

config SENSORS_KXTJ9
        tristate "KXTJ9 g-sensor sensor"
        depends on I2C

config SENSORS_AK09911
        tristate "AK09911 compass support"
        depends on I2C
        help
          If you say yes here you get support for Asahi Kasei's
          orientation sensor AK09911.

config HALL_SENSOR
        bool "Hall sensor support"
        default n

config SENSORS_AK09911_a600cg
        tristate "AK09911 compass support"
	 depends on I2C
	 help
	   If you say yes here you get support for Asahi Kasei's
	   orientation sensor AK09911.
```

## linux/kernel/drivers/power/ASUS_BATTERY/Kconfig
```kconfig
#
#  Copyright (c) 2013, ASUSTek, Inc. All Rights Reserved.
#  Written by chih-hsuan chang chih-hsuan_chang@asus.com
#
#  Battery driver configuration
#
menuconfig A500CG_BATTERY
	bool "A500CG Battery support"
        default y
	help
	  Say Y here. This option doesn't affect the kernel.
	  If unsure, say Y.

menuconfig ASUS_ENGINEER_MODE
	bool "A500CG Battery Engineer Mode"
	default y
	help
	  Say Y here. This option doesn't affect the kernel.
	  If unsure, say Y.

if A500CG_BATTERY

config A500CG_BATTERY_SMB347
	tristate "SMB347 battery charger driver"
	depends on I2C
        default y
	help
	  Say Y to enable support for the SMB347 switching mode based charger
	  and sysfs. The driver supports controlling charger-enable and
	  current limiting capabilities. The driver also lets the
	  SMB347 be operated as a slave device via the power supply
	  framework.

config UPI_BATTERY
	tristate "UPI uG31xx battery driver"
	depends on I2C
	help
	  Say Y to support for batteries with uG31xx chip.

config BATTERY_MAX17048
	tristate "Maxim MAX17048 Fuel Gauge"
	depends on I2C
	help
	  MAX17048 is fuel-gauge systems for lithium-ion (Li+) batteries
	  in handheld and portable equipment. The MAX17048 is configured
	  to operate with a single lithium cell.
endif
```

## linux/kernel/kernel/tkb/Kconfig
```kconfig
config TINKERBELL
	tristate "Intel Tinkerbell"
	---help---
	 Very good
	default m
```

## linux/modules/camera/drivers/media/i2c/Kconfig
```kconfig
#
# Kconfig for sensor drivers
#

source "drivers/external_drivers/camera/drivers/media/i2c/mt9e013/Kconfig"
source "drivers/external_drivers/camera/drivers/media/i2c/ov5693/Kconfig"
source "drivers/external_drivers/camera/drivers/media/i2c/imx/Kconfig"
source "drivers/external_drivers/camera/drivers/media/i2c/imx135VB/Kconfig"
source "drivers/external_drivers/camera/drivers/media/i2c/imx219/Kconfig"
source "drivers/external_drivers/camera/drivers/media/i2c/imx111/Kconfig"
source "drivers/external_drivers/camera/drivers/media/i2c/t4k37/Kconfig"

config VIDEO_OV9724
       tristate "OVT ov9724 sensor support"
       depends on I2C && VIDEO_V4L2
       ---help---
         This is a Video4Linux2 sensor-level driver for the OVT
         OV9724 raw camera.

         OVT is a 720P raw sensor.

         It currently only works with the atomisp driver.

config VIDEO_OV2722
       tristate "OVT ov2722 sensor support"
       depends on I2C && VIDEO_V4L2
       ---help---
         This is a Video4Linux2 sensor-level driver for the OVT
         OV2722 raw camera.

         OVT is a 2M raw sensor.

         It currently only works with the atomisp driver.

config VIDEO_OV8830
       tristate "Omnivision ov8830 sensor support"
       depends on I2C && VIDEO_V4L2 && VIDEO_ATOMISP
       ---help---
         This is a Video4Linux2 sensor-level driver for the Omnivision
         ov8830 8MP RAW sensor.

         It currently only works with the atomisp driver.

config VIDEO_MN34130
       tristate "Panasonic MN34130 sensor support"
       depends on I2C && VIDEO_V4L2 && VIDEO_ATOMISP
       ---help---
         This is a Video4Linux2 sensor-level driver for the Panasonic
         mn34130 13MP RAW sensor.

         It currently only works with the atomisp driver.

config VIDEO_MSRLIST_HELPER
       tristate "Helper library to load, parse and apply large register lists."
       depends on I2C
       ---help---
         This is a helper library to be used from a sensor driver to load, parse
         and apply large register lists.

         To compile this driver as a module, choose M here: the
         module will be called libmsrlisthelper.

config VIDEO_S5K8AAY
       tristate "Samsung S5K8AAY (EVT1) sensor support"
       depends on I2C && VIDEO_V4L2 && VIDEO_ATOMISP && VIDEO_MSRLIST_HELPER
       ---help---
         This is a Video4Linux2 sensor-level driver for the Samsung
         S5K8AAY (EVT1) 1/8" 1.2MP SoC sensor.

         It currently only works with the atomisp driver.

config VIDEO_MT9D113
       tristate "Aptina mt9d113 sensor support"
       depends on I2C && VIDEO_V4L2
       ---help---
         This is a Video4Linux2 sensor-level driver for the Micron
         mt9d113 2M camera.

         mt9d113 is video camera sensor.

         It currently only works with the atomisp driver.
config VIDEO_MT9M114
       tristate "Aptina mt9m114 sensor support"
       depends on I2C && VIDEO_V4L2
       ---help---
         This is a Video4Linux2 sensor-level driver for the Micron
         mt9m114 1.3 Mpixel camera.

         mt9m114 is video camrea sensor.
config VIDEO_GC0339
       tristate "Gcoreinc gc0339 sensor support"
       depends on I2C && VIDEO_V4L2
       ---help---
         This is a Video4Linux2 sensor-level driver for the Gcoreinc
         gc0339 0.3 Mpixel camera.

         gc0339 is video camrea sensor.

         It currently only works with the atomisp driver.

config VIDEO_GC0310
       tristate "Gcoreinc gc0310 sensor support"
       depends on I2C && VIDEO_V4L2
       ---help---
         This is a Video4Linux2 sensor-level driver for the Gcoreinc
         gc0310 0.3 Mpixel camera.

         gc0310 is video camrea sensor.

         It currently only works with the atomisp driver.

config VIDEO_HM2056
       tristate "Himax hm2056 sensor support"
       depends on I2C && VIDEO_V4L2
       ---help---
         This is a Video4Linux2 sensor-level driver for the Himax
         hm2056 2M camera.

         hm2056 is video camrea sensor.

config VIDEO_MT9V113
       tristate "Aptina mt9v113 sensor support"
       depends on I2C && VIDEO_V4L2
       ---help---
         This is a Video4Linux2 sensor-level driver for the Micron
         mt9v113 vga camera.

         mt9v113 is video camerea sensor.

         It currently only works with the atomisp driver.

config VIDEO_OV5640
       tristate "Omnivision ov5640 sensor support"
       depends on I2C && VIDEO_V4L2
       ---help---
         This is a Video4Linux2 sensor-level driver for the Micron
         ov5640 5 Mpixel camera.

         ov5640 is video camrea sensor.

         It currently only works with the atomisp driver.

config VIDEO_AP1302
       tristate "AP1302 external ISP support"
       depends on I2C && VIDEO_V4L2
       ---help---
         This is a Video4Linux2 sensor-level driver for the external
         ISP AP1302.

         AP1302 is an exteral ISP.

         It currently only works with the atomisp driver.

#
# Kconfig for flash drivers
#

config VIDEO_LM3554
       tristate "LM3554 flash light driver"
       depends on VIDEO_V4L2 && I2C
       ---help---
         This is a Video4Linux2 sub-dev driver for the LM3554
         flash light driver.

         To compile this driver as a module, choose M here: the
         module will be called lm3554

config VIDEO_LM3559
       tristate "LM3559 flash light driver"
       depends on VIDEO_V4L2 && I2C
       ---help---
         This is a Video4Linux2 sub-dev driver for the LM3559
         flash light driver.

         To compile this driver as a module, choose M here: the
         module will be called lm3559


config VIDEO_RT8515
        tristate "RT8515 flash light driver"
        depends on VIDEO_V4L2
        ---help---
          This is a Video4Linux2 int device driver for the RT8515
          flash light driver.

          To compile this driver as a module, choose M here: the
          module will be called rt8515
```

## linux/modules/camera/drivers/media/i2c/imx111/Kconfig
```kconfig
config VIDEO_IMX111
	tristate "Sony IMX111 8Mp raw sensor"
	depends on I2C && VIDEO_V4L2
	---help---
	  This is sensor driver for Sony IMX111 raw sensor.

	  It currently depends on VIDEO_IMX defined in the above section.
```

## linux/modules/camera/drivers/media/i2c/imx219/Kconfig
```kconfig
config VIDEO_IMX219
	tristate "Sony IMX219 8Mp raw sensor"
	depends on I2C && VIDEO_V4L2
	---help---
	  This is sensor driver for Sony IMX219 raw sensor.

	  It currently depends on VIDEO_IMX defined in the above section.
```

## linux/modules/drivers/gpio/Kconfig
```kconfig
config GPIO_CRYSTALCOVE
	bool "Intel ValleyView Crystalcove GPIO support"
	select IRQ_DOMAIN
	help
	  This driver is for Intel ValleyView.

	  Say Y here to support Intel ValleyView Crystalcove GPIO.
```

## linux/modules/drivers/input/misc/Kconfig
```kconfig
config INPUT_INTEL_MID_VIBRA
	tristate "Support for Intel MID Vibrator"
	help
	This option enables support for Intel Mid Vibrator Driver. Say Y
	here if you want to enable the vibrator functionality for CTP

	To compile this driver as a module, choose M here. The module will
	be called intel_mid_vibra.
```

## linux/modules/drivers/switch/Kconfig
```kconfig
config SWITCH_MID
	tristate "Jack Switch support"
        depends on SWITCH
	help
	  Say Y here to support switch driver for audio jack detection.

config SWITCH_MID_USER_NOTIFY
	tristate "Userspace notification Switch support"
	help
	  Say Y here to support USER_NOTIFY switch. Needed for devices where
	  userspace requires notification of specific device events reported by drivers to
	  the USER_NOTIFY switch driver.
```
